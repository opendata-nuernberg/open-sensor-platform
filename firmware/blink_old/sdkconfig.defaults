## firmware/blink_old/sdkconfig.defaults
```kconfig
CONFIG_IDF_TARGET_ARCH_RISCV=y
CONFIG_IDF_TARGET_ARCH="riscv"
CONFIG_IDF_TARGET="esp32c3"
CONFIG_IDF_INIT_VERSION="5.4.0"
CONFIG_IDF_TARGET_ESP32C3=y
CONFIG_ESPTOOLPY_FLASHSIZE="4MB"
```
